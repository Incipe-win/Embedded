#include <reg51.h>

unsigned char led1_mod[] = {0x3f, 0x06, 0x5b, 0x4f, 0x66, 0x6d, 0x7d, 0x07,
                           0x7f, 0x6f, 0x77, 0x7c, 0x58, 0x5e, 0x79, 0x71};
unsigned char led2_mod[] = {0x3f, 0x06, 0x5b, 0x4f, 0x66, 0x6d, 0x7d, 0x07,
                           0x7f, 0x6f, 0x77, 0x7c, 0x58, 0x5e, 0x79, 0x71};

unsigned char count1 = 0, count2 = 0;

void INT_0SRV() interrupt 0 { 
	if (count1 == 10) {
		count1 = 0;
		++count2;
	}
	P2 = led1_mod[count1++];
	if (count2 == 10) {
		count2 = 0;
	}
	P1 = led1_mod[count2];
}

void main() {
	P1 = 0x00;
	P2 = 0x00;
  EA = 1;
  EX0 = 1;
  EX1 = 1;
  IT1 = 1;
  IT0 = 1;
	while (1) {
		;
	}
}